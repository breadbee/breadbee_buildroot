/dts-v1/;
/plugin/;

/ {
	compatible = "thingyjp,thumbee";

	fragment@0 {
		target = <&mspi0>;
		__overlay__ {
			display@0{
				compatible = "ilitek,ili9341";
				reg = <0>;
				regwidth = <8>;
				buswidth = <8>;
				verbose = <3>;
				spi-max-frequency = <32000000>;
				dc-gpios = <&gpio 10 0>;
				reset-gpios = <&gpio 11 0>;
				rotation = <270>;
			};
		};
	};
};

