/dts-v1/;
/plugin/;

/ {
	compatible = "thingyjp,thumbee";

	fragment@0 {
		target = <&pwm4>;
		__overlay__ {
			pinctrl-names = "default";
			pinctrl-0 = <&pwm4_spi0_cz_pins>;
			status = "okay";
		};
	};
};
