/dts-v1/;
/plugin/;

/ {
	compatible = "thingyjp,thumbee";

	fragment@0 {
		target = <&mspi0>;
		__overlay__ {
			spidev@0 {
				compatible = "spidev";
				spi-max-frequency = <10000>;
				reg = <0>;
			};
		};
	};
};

