//bbovly-category:pwm
//bbovly-type:device
//bbovly-consumes:j2_p9

/dts-v1/;
/plugin/;

/ {
	compatible = "thingyjp,thumbee";

	fragment@0 {
		target = <&pwm6>;
		__overlay__ {
			pinctrl-names = "default";
			pinctrl-0 = <&pwm6_spi0_di_pins>;
			status = "okay";
		};
	};
};
