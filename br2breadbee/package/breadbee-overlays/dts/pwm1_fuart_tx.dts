//bbovly-category:pwm
//bbovly-type:device
//bbovly-consumes:j2_p16

/dts-v1/;
/plugin/;

/ {
	compatible = "thingyjp,thumbee";

	fragment@0 {
		target = <&pwm1>;
		__overlay__ {
			pinctrl-names = "default";
			pinctrl-0 = <&pwm1_fuart_tx_pins>;
			status = "okay";
		};
	};
};
