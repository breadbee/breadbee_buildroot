//bbovly-category:spi
//bbovly-type:device

/dts-v1/;
/plugin/;

/ {
	compatible = "thingyjp,thumbee";

	fragment@0 {
		target = <&mspi0>;
		__overlay__ {
			display@0{
				compatible = "ilitek,ili9341";
				reg = <0>;
				regwidth = <8>;
				buswidth = <8>;
				verbose = <3>;
				spi-max-frequency = <10000000>;
				dc-gpios = <&gpio 10 0>;    /* sr_io6 */
				reset-gpios = <&gpio 11 0>; /* sr_io7 */
				rotation = <270>;
				bgr;
			};
		};
	};
};

