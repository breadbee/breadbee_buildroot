//bbovly-category:i2c
//bbovly-type:device
//bbovly-consumes:i2c1

/dts-v1/;
/plugin/;

/ {
	compatible = "thingyjp,thumbee";

	fragment@0 {
		target = <&i2c1>;
		__overlay__ {
			ds1307@68 {
				compatible = "dallas,ds1307";
				reg = <0x68>;
			};
		};
	};
};

