//bbovly-category:uart
//bbovly-type:device
//bbovly-consumes:j2_p17,j2_p18

/dts-v1/;
/plugin/;

/ {
	compatible = "thingyjp,thumbee";

	fragment@0 {
		target = <&uart1>;
		__overlay__ {
			status = "okay";
		};
	};
};
