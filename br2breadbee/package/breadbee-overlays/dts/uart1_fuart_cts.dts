//bbovly-category:uart
//bbovly-type:device
//bbovly-consumes:j2_p17

/dts-v1/;
/plugin/;

/ {
	compatible = "thingyjp,thumbee";

	fragment@0 {
		target = <&uart1>;
		__overlay__ {
			pinctrl-0 = <&uart1_cts_pins>;
			status = "okay";
		};
	};
};
