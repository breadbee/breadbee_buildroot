//bbovly-category:sd
//bbovly-type:device
//bbovly-consumes:j4_p2,j4_p3,j4_p4,j4_p5,j4_p6,j4_p7,j4_p8

/dts-v1/;
/plugin/;

/ {
	compatible = "thingyjp,thumbee";

	fragment@0 {
		target = <&sdio>;
		__overlay__ {
			status = "okay";
		};
	};
};

