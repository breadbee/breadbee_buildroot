//bbovly-category:pwm
//bbovly-type:device
//bbovly-consumes:j2_p8

/dts-v1/;
/plugin/;

/ {
	compatible = "thingyjp,thumbee";

	fragment@0 {
		target = <&pwm5>;
		__overlay__ {
			pinctrl-names = "default";
			pinctrl-0 = <&pwm5_spi0_ck_pins>;
			status = "okay";
		};
	};
};
