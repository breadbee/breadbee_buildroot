//bbovly-category:spi
//bbovly-type:interface
//bbovly-consumes:j2_p7,j2_p8,j2_p9,j2_p10
//bbovly-provides:spi0

/dts-v1/;
/plugin/;

/ {
	compatible = "thingyjp,thumbee";

	fragment@0 {
		target = <&mspi0>;
		__overlay__ {
			status = "okay";
			pinctrl-names = "default";
			pinctrl-0 = <&spi0_spi0_pins>;
		};
	};
};

