//bbovly-category:spi
//bbovly-type:interface
//bbovly-consumes:j4_p2,j4_p3,j4_p4,j4_p5

/dts-v1/;
/plugin/;

/ {
	compatible = "thingyjp,thumbee";

	fragment@0 {
		target = <&mspi1>;
		__overlay__ {
			status = "okay";
			pinctrl-names = "default";
			pinctrl-0 = <&spi1_sd_d0_d1_d2_d3_pins>;
		};
	};
};

