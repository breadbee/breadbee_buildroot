//bbovly-category:spi
//bbovly-type:interface
//bbovly-consumes:j2_p15,j2_p16,j2_p17,j2_p18
//bbovly-provides:spi0

/dts-v1/;
/plugin/;

/ {
	compatible = "thingyjp,thumbee";

	fragment@0 {
		target = <&mspi0>;
		__overlay__ {
			status = "okay";
			pinctrl-names = "default";
			pinctrl-0 = <&spi0_fuart_pins>;
		};
	};
};

