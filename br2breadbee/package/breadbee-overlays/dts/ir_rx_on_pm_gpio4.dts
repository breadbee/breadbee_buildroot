//bbovly-category:ir
//bbovly-type:device

/dts-v1/;
/plugin/;

/ {
	compatible = "thingyjp,thumbee";

	fragment@0 {
		target-path = "/";
		__overlay__ {
			ir_rx@0 {
				compatible = "gpio-ir-receiver";
				gpios = <&pm_pinctrl 0 0>;
			};		
		};
	};
};

