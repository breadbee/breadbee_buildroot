//bbovly-category:adc

/dts-v1/;
/plugin/;

/ {
	compatible = "thingyjp,thumbee";

	fragment@0 {
		target = <&sar>;
		__overlay__ {
			status = "okay";
			pinctrl-names = "default";
			pinctrl-0 = <&sar1_gpio1_pins>, <&sar2_gpio2_pins>, <&sar3_gpio3_pins>;
		};
	};
};

