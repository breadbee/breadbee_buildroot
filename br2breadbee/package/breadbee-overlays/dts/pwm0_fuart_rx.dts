//bbovly-category:pwm
//bbovly-type:device
//bbovly-consumes:j2_p15

/dts-v1/;
/plugin/;

/ {
	compatible = "thingyjp,thumbee";

	fragment@0 {
		target = <&pwm0>;
		__overlay__ {
			pinctrl-names = "default";
			pinctrl-0 = <&pwm0_fuart_rx_pins>;
			status = "okay";
		};
	};
};
