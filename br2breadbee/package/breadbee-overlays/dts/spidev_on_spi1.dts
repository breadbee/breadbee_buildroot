//bbovly-category:spi

/dts-v1/;
/plugin/;

/ {
	compatible = "thingyjp,thumbee";

	fragment@0 {
		target = <&mspi1>;
		__overlay__ {
			spidev@1 {
				compatible = "spidev";
				spi-max-frequency = <10000000>;
				reg = <0>;
			};
		};
	};
};

