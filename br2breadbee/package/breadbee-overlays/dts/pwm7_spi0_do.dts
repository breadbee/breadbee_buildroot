//bbovly-category:pwm
//bbovly-type:device
//bbovly-consumes:j2_p10

/dts-v1/;
/plugin/;

/ {
	compatible = "thingyjp,thumbee";

	fragment@0 {
		target = <&pwm7>;
		__overlay__ {
			pinctrl-names = "default";
			pinctrl-0 = <&pwm7_spi0_do_pins>;
			status = "okay";
		};
	};
};
