//bbovly-category:adc

/dts-v1/;
/plugin/;

/ {
	compatible = "thingyjp,thumbee";

	fragment@0 {
		target = <&sar>;
		__overlay__ {
			status = "okay";
			pinctrl-names = "default";
			pinctrl-0 = <&sar0_gpio0_pins>, <&sar2_gpio2_pins>;
		};
	};
};

