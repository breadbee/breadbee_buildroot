//bbovly-category:pwm
//bbovly-type:device

/dts-v1/;
/plugin/;

/ {
	compatible = "thingyjp,thumbee";

	fragment@0 {
		target = <&pwm2>;
		__overlay__ {
			pinctrl-names = "default";
			pinctrl-0 = <&pwm2_fuart_cts_pins>;
			status = "okay";
		};
	};
};
