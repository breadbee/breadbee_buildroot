## br2apps/package/myapp/Config.in
```kconfig
config BR2_PACKAGE_MYAPP
        bool "myapp"
	select BR2_PACKAGE_PYTHON3
        help
          MyApp
```

## br2breadbee/Config.in
```kconfig
source "$BR2_EXTERNAL_BREADBEE_PATH/package/breadbee-overlays/Config.in"
source "$BR2_EXTERNAL_BREADBEE_PATH/package/beecfg/Config.in"
source "$BR2_EXTERNAL_BREADBEE_PATH/package/ptftpd/Config.in"
source "$BR2_EXTERNAL_BREADBEE_PATH/package/flasher/Config.in"
source "$BR2_EXTERNAL_BREADBEE_PATH/package/python-sbus/Config.in"
source "$BR2_EXTERNAL_BREADBEE_PATH/package/python-pylx16a/Config.in"
source "$BR2_EXTERNAL_BREADBEE_PATH/package/python-tinyodrive/Config.in"
source "$BR2_EXTERNAL_BREADBEE_PATH/package/rwsetup/Config.in"
source "$BR2_EXTERNAL_BREADBEE_PATH/package/sandbox/Config.in"
source "$BR2_EXTERNAL_BREADBEE_PATH/package/swankypython/Config.in"
source "$BR2_EXTERNAL_BREADBEE_PATH/package/libxmp/Config.in"
source "$BR2_EXTERNAL_BREADBEE_PATH/package/xmp/Config.in"

config BR2_BREADBEE_MFGTOOLS
	bool "install stuff for mfg"
	select BR2_PACKAGE_FLASHROM
	select BR2_PACKAGE_DHRYSTONE
	help
	  Install packages used at mfg
```

## br2breadbee/board/thingyjp/breadbee/kernel.its
```
/dts-v1/;

/ {
	description = "Breadbee Firmware";
	#address-cells = <1>;

	images {
		kernel-0 {
			data = /incbin/("../../images/zImage");
			type = "kernel";
			arch = "arm";
			os = "linux";
			compression = "none";
			load = <0x22800000>;
                        entry = <0x22800000>;
			hash@1 {
				algo = "crc32";
			};
			hash@2 {
				algo = "sha1";
			};
		};
		fdt-0 {
			data = /incbin/("../../images/mstar-infinity3-msc313e-breadbee.dtb");
			type = "flat_dt";
			arch = "arm";
			compression = "none";
			load = <0x23000000>;
			hash@1 {
				algo = "crc32";
			};
			hash@2 {
				algo = "sha1";
			};
		};
		fdt-1 {
			data = /incbin/("../../images/mstar-infinity-msc313-breadbee_crust.dtb");
			type = "flat_dt";
			arch = "arm";
			compression = "none";
			load = <0x23000000>;
			hash@1 {
				algo = "crc32";
			};
			hash@2 {
				algo = "sha1";
			};
		};
		fdt-2 {
			data = /incbin/("../../images/mstar-infinity3-msc313e-wiibee.dtb");
			type = "flat_dt";
			arch = "arm";
			compression = "none";
			load = <0x23000000>;
			hash@1 {
				algo = "crc32";
			};
			hash@2 {
				algo = "sha1";
			};
		};
		/include/ "../../images/breadbee-overlays/fdtlist"
	};

	configurations {
		default = "breadbee";
		breadbee {
			kernel = "kernel-0";
			fdt = "fdt-0";
		};
		breadbee_crust {
			kernel = "kernel-0";
			fdt = "fdt-1";
		};
		wiibee {
			kernel = "kernel-0";
			fdt = "fdt-2";
		};
		/include/ "../../images/breadbee-overlays/configlist"
	};
};
```

## br2breadbee/configs/breadbee_defconfig
```kconfig
BR2_arm=y
BR2_cortex_a7=y
BR2_ARM_FPU_NEON=y
BR2_CCACHE=y
BR2_TOOLCHAIN_BUILDROOT_GLIBC=y
BR2_TOOLCHAIN_BUILDROOT_CXX=y
BR2_GCC_ENABLE_LTO=y
BR2_GCC_ENABLE_GRAPHITE=y
BR2_TARGET_GENERIC_HOSTNAME="breadbee"
BR2_TARGET_GENERIC_ISSUE="Welcome to breadbee. Your user is 'bzzbzz'. Type 'sudo beecfg' after logging in to start configuration."
# BR2_TARGET_ENABLE_ROOT_LOGIN is not set
# BR2_TARGET_GENERIC_REMOUNT_ROOTFS_RW is not set
BR2_SYSTEM_DHCP="eth0"
BR2_ENABLE_LOCALE_WHITELIST="C"
BR2_ROOTFS_USERS_TABLES="$(BR2_EXTERNAL_BREADBEE_PATH)/users"
BR2_ROOTFS_OVERLAY="$(BR2_EXTERNAL_BREADBEE_PATH)/overlay/"
BR2_ROOTFS_POST_IMAGE_SCRIPT="support/scripts/genimage.sh"
BR2_ROOTFS_POST_SCRIPT_ARGS="-c $(BR2_EXTERNAL_BREADBEE_PATH)/board/thingyjp/breadbee/genimage.cfg"
BR2_LINUX_KERNEL=y
BR2_LINUX_KERNEL_CUSTOM_GIT=y
BR2_LINUX_KERNEL_CUSTOM_REPO_URL="https://github.com/fifteenhex/linux.git"
BR2_LINUX_KERNEL_CUSTOM_REPO_VERSION="mstar_v5_9_rebase"
BR2_LINUX_KERNEL_USE_CUSTOM_CONFIG=y
BR2_LINUX_KERNEL_CUSTOM_CONFIG_FILE="$(BR2_EXTERNAL_BREADBEE_PATH)/board/thingyjp/breadbee/linux.config"
BR2_LINUX_KERNEL_CONFIG_FRAGMENT_FILES="$(BR2_PACKAGE_BREADBEE_OVERLAYS_FPGA_KERNEL_FRAGMENT) $(BR2_PACKAGE_BREADBEE_OVERLAYS_IR_KERNEL_FRAGMENT) $(BR2_PACKAGE_BREADBEE_OVERLAYS_USB_KERNEL_FRAGMENT) $(BR2_PACKAGE_BREADBEE_OVERLAYS_USB_AUDIO_KERNEL_FRAGMENT) $(BR2_PACKAGE_BREADBEE_OVERLAYS_SD_KERNEL_FRAGMENT) $(BR2_PACKAGE_BREADBEE_OVERLAYS_EXT4_KERNEL_FRAGMENT) $(BR2_EXTERNAL_BREADBEE_PATH)/configs/kernel_fragments/ch341"
BR2_LINUX_KERNEL_XZ=y
BR2_LINUX_KERNEL_DTS_SUPPORT=y
BR2_LINUX_KERNEL_INTREE_DTS_NAME="mstar-infinity3-msc313e-breadbee mstar-infinity-msc313-breadbee_crust mstar-infinity3-msc313e-wiibee"
BR2_LINUX_KERNEL_DTB_OVERLAY_SUPPORT=y
BR2_PACKAGE_BUSYBOX_CONFIG_FRAGMENT_FILES="$(BR2_EXTERNAL_BREADBEE_PATH)/board/thingyjp/breadbee/busybox_snippets/00-smallify"
BR2_PACKAGE_BUSYBOX_WATCHDOG=y
BR2_PACKAGE_LIBUBOOTENV=y
# BR2_PACKAGE_PYTHON3_UNICODEDATA is not set
BR2_PACKAGE_LIBGPIOD=y
BR2_PACKAGE_LIBGPIOD_TOOLS=y
BR2_PACKAGE_LIBIIO=y
# BR2_PACKAGE_LIBIIO_XML_BACKEND is not set
# BR2_PACKAGE_LIBIIO_NETWORK_BACKEND is not set
# BR2_PACKAGE_LIBIIO_USB_BACKEND is not set
# BR2_PACKAGE_LIBIIO_SERIAL_BACKEND is not set
# BR2_PACKAGE_LIBIIO_IIOD is not set
BR2_PACKAGE_LIBIIO_BINDINGS_PYTHON=y
BR2_PACKAGE_HAVEGED=y
BR2_PACKAGE_DROPBEAR=y
BR2_PACKAGE_NTP=y
BR2_PACKAGE_NTP_SNTP=y
# BR2_PACKAGE_NTP_NTPD is not set
BR2_PACKAGE_SUDO=y
BR2_TARGET_ROOTFS_CPIO=y
BR2_TARGET_ROOTFS_SQUASHFS=y
BR2_TARGET_ROOTFS_SQUASHFS4_XZ=y
# BR2_TARGET_ROOTFS_TAR is not set
BR2_TARGET_UBOOT=y
BR2_TARGET_UBOOT_BUILD_SYSTEM_KCONFIG=y
BR2_TARGET_UBOOT_CUSTOM_GIT=y
BR2_TARGET_UBOOT_CUSTOM_REPO_URL="https://github.com/fifteenhex/u-boot.git"
BR2_TARGET_UBOOT_CUSTOM_REPO_VERSION="mstar"
BR2_TARGET_UBOOT_BOARD_DEFCONFIG="msc313_breadbee"
BR2_TARGET_UBOOT_FORMAT_IMG=y
BR2_TARGET_UBOOT_SPL=y
BR2_PACKAGE_HOST_GENIMAGE=y
BR2_PACKAGE_HOST_UBOOT_TOOLS=y
BR2_PACKAGE_HOST_UBOOT_TOOLS_FIT_SUPPORT=y
BR2_PACKAGE_HOST_UBOOT_TOOLS_FIT_SIGNATURE_SUPPORT=y
BR2_PACKAGE_AUTOSSHKEY=y
BR2_PACKAGE_AUTOSSHKEY_USERS="bzzbzz"
BR2_PACKAGE_AUTOSSHKEY_SUDOUSERS="bzzbzz"
BR2_PACKAGE_SANETIME=y
BR2_PACKAGE_BREADBEE_OVERLAYS_ADC=y
BR2_PACKAGE_BREADBEE_OVERLAYS_I2C=y
BR2_PACKAGE_BREADBEE_OVERLAYS_PWM=y
BR2_PACKAGE_BREADBEE_OVERLAYS_SPI=y
BR2_PACKAGE_BREADBEE_OVERLAYS_SD=y
BR2_PACKAGE_BREADBEE_OVERLAYS_UART=y
BR2_PACKAGE_BREADBEE_OVERLAYS_USB=y
BR2_PACKAGE_BREADBEE_OVERLAYS_USB_AUDIO=y
BR2_PACKAGE_BEECFG=y
BR2_PACKAGE_HOST_PTFTPD=y
BR2_PACKAGE_PYTHON_PYLX16A=y
BR2_PACKAGE_RWSETUP=y
BR2_PACKAGE_SWANKYPYTHON=y
```

## br2breadbee/configs/breadbee_rescue_defconfig
```kconfig
BR2_arm=y
BR2_cortex_a7=y
BR2_ARM_FPU_NEON=y
BR2_ARM_INSTRUCTIONS_THUMB2=y
BR2_CCACHE=y
BR2_KERNEL_HEADERS_5_1=y
BR2_BINUTILS_VERSION_2_32_X=y
BR2_GCC_VERSION_8_X=y
BR2_GCC_ENABLE_LTO=y
BR2_GCC_ENABLE_GRAPHITE=y
BR2_TARGET_GENERIC_HOSTNAME="breadbee"
BR2_TARGET_GENERIC_ISSUE="Welcome to breadbee. "
BR2_SYSTEM_DHCP="eth0"
BR2_ROOTFS_USERS_TABLES="$(BR2_EXTERNAL_BREADBEE_PATH)/users"
BR2_ROOTFS_OVERLAY="$(BR2_EXTERNAL_BREADBEE_PATH)/overlay/"
BR2_ROOTFS_POST_IMAGE_SCRIPT="support/scripts/genimage.sh"
BR2_ROOTFS_POST_SCRIPT_ARGS="-c $(BR2_EXTERNAL_BREADBEE_PATH)/board/thingyjp/breadbee/genimage_rescue.cfg"
BR2_LINUX_KERNEL=y
BR2_LINUX_KERNEL_CUSTOM_GIT=y
BR2_LINUX_KERNEL_CUSTOM_REPO_URL="https://github.com/fifteenhex/linux.git"
BR2_LINUX_KERNEL_CUSTOM_REPO_VERSION="msc313e"
BR2_LINUX_KERNEL_USE_CUSTOM_CONFIG=y
BR2_LINUX_KERNEL_CUSTOM_CONFIG_FILE="$(BR2_EXTERNAL_BREADBEE_PATH)/board/thingyjp/breadbee/linux.config"
BR2_LINUX_KERNEL_CONFIG_FRAGMENT_FILES="$(BR2_EXTERNAL_BREADBEE_PATH)/board/thingyjp/breadbee/rescue_linux_snippets/00-disable-4k-sectors $(BR2_EXTERNAL_BREADBEE_PATH)/board/thingyjp/breadbee/rescue_linux_snippets/01-smallify"
BR2_LINUX_KERNEL_XZ=y
BR2_LINUX_KERNEL_DTS_SUPPORT=y
BR2_LINUX_KERNEL_INTREE_DTS_NAME="msc313e-breadbee msc313-breadbee_crust"
BR2_PACKAGE_BUSYBOX_WATCHDOG=y
BR2_PACKAGE_MTD=y
# BR2_PACKAGE_MTD_MTD_DEBUG is not set
# BR2_PACKAGE_MTD_NANDDUMP is not set
# BR2_PACKAGE_MTD_NANDTEST is not set
# BR2_PACKAGE_MTD_NANDWRITE is not set
# BR2_PACKAGE_MTD_MTDINFO is not set
# BR2_PACKAGE_MTD_UBIATTACH is not set
# BR2_PACKAGE_MTD_UBICRC32 is not set
# BR2_PACKAGE_MTD_UBIDETACH is not set
# BR2_PACKAGE_MTD_UBIFORMAT is not set
# BR2_PACKAGE_MTD_UBIMKVOL is not set
# BR2_PACKAGE_MTD_UBINFO is not set
# BR2_PACKAGE_MTD_UBINIZE is not set
# BR2_PACKAGE_MTD_UBIRENAME is not set
# BR2_PACKAGE_MTD_UBIRMVOL is not set
# BR2_PACKAGE_MTD_UBIRSVOL is not set
# BR2_PACKAGE_MTD_UBIUPDATEVOL is not set
# BR2_PACKAGE_MTD_UBIBLOCK is not set
BR2_PACKAGE_DROPBEAR=y
# BR2_PACKAGE_DROPBEAR_CLIENT is not set
BR2_PACKAGE_SUDO=y
BR2_TARGET_ROOTFS_CPIO_XZ=y
BR2_TARGET_ROOTFS_INITRAMFS=y
# BR2_TARGET_ROOTFS_TAR is not set
BR2_PACKAGE_HOST_GENIMAGE=y
BR2_PACKAGE_HOST_UBOOT_TOOLS=y
BR2_PACKAGE_HOST_UBOOT_TOOLS_FIT_SUPPORT=y
BR2_PACKAGE_HOST_UBOOT_TOOLS_FIT_SIGNATURE_SUPPORT=y
BR2_PACKAGE_AUTOSSHKEY=y
BR2_PACKAGE_AUTOSSHKEY_USERS="bzzbzz"
BR2_PACKAGE_AUTOSSHKEY_SUDOUSERS="bzzbzz"
BR2_PACKAGE_SANETIME=y
BR2_PACKAGE_BREADBEE_OVERLAYS=y
BR2_PACKAGE_FLASHER=y
```

## br2breadbee/package/beecfg/Config.in
```kconfig
config BR2_PACKAGE_BEECFG
        bool "beecfg"
	select BR2_PACKAGE_BREADBEE_OVERLAYS
	select BR2_PACKAGE_PYTHON3
        select BR2_PACKAGE_PYTHON_DIALOG3
        help
          BeeCfg
```

## br2breadbee/package/breadbee-overlays/Config.in
```kconfig
config BR2_PACKAGE_BREADBEE_OVERLAYS
	bool "breadbee overlays"
	select BR2_PACKAGE_HOST_DTC
	help
	  Breadbee overlays

if BR2_PACKAGE_BREADBEE_OVERLAYS

# ADC support
config	BR2_PACKAGE_BREADBEE_OVERLAYS_ADC
	bool "ADC support"
	help
	  ADC support

if BR2_PACKAGE_BREADBEE_OVERLAYS_ADC
config BR2_PACKAGE_BREADBEE_OVERLAYS_ADC_KERNEL_FRAGMENT
	string
	default "$(BR2_EXTERNAL_BREADBEE_PATH)/configs/kernel_fragments/adc"
endif

# FPGA support
config  BR2_PACKAGE_BREADBEE_OVERLAYS_FPGA
	bool "FPGA support"
	help
	  FPGA support

if BR2_PACKAGE_BREADBEE_OVERLAYS_FPGA
config BR2_PACKAGE_BREADBEE_OVERLAYS_FPGA_KERNEL_FRAGMENT
	string
	default "$(BR2_EXTERNAL_BREADBEE_PATH)/configs/kernel_fragments/fpga"
endif

# I2C support
config	BR2_PACKAGE_BREADBEE_OVERLAYS_I2C
	bool "I2C support"
	help
	  I2C support

if BR2_PACKAGE_BREADBEE_OVERLAYS_I2C
config BR2_PACKAGE_BREADBEE_OVERLAYS_I2C_KERNEL_FRAGMENT
	string
	default "$(BR2_EXTERNAL_BREADBEE_PATH)/configs/kernel_fragments/i2c"
endif

# IR support
config	BR2_PACKAGE_BREADBEE_OVERLAYS_IR
	bool "IR support"
	select BR2_PACKAGE_LIRC_TOOLS
	help
	  IR support

if BR2_PACKAGE_BREADBEE_OVERLAYS_IR
config BR2_PACKAGE_BREADBEE_OVERLAYS_IR_KERNEL_FRAGMENT
	string
	default "$(BR2_EXTERNAL_BREADBEE_PATH)/configs/kernel_fragments/lirc"
endif

# PWM support
config	BR2_PACKAGE_BREADBEE_OVERLAYS_PWM
	bool "PWM support"
	help
	  PWM support

config  BR2_PACKAGE_BREADBEE_OVERLAYS_W1
        bool "W1 support"
        help
          W1 support

# SPI support
config	BR2_PACKAGE_BREADBEE_OVERLAYS_SPI
	bool "SPI support"
	select BR2_PACKAGE_SPI_TOOLS
	help
	  SPI support

# SD support
config  BR2_PACKAGE_BREADBEE_OVERLAYS_SD
	bool "SD/SDIO support"
	help
	  SD/SDIO support

if BR2_PACKAGE_BREADBEE_OVERLAYS_SD
config BR2_PACKAGE_BREADBEE_OVERLAYS_SD_KERNEL_FRAGMENT
	string
	default "$(BR2_EXTERNAL_BREADBEE_PATH)/configs/kernel_fragments/sd"
endif

# UART support
config  BR2_PACKAGE_BREADBEE_OVERLAYS_UART
	bool "UART support"
	help
	  UART support

# USB support
config  BR2_PACKAGE_BREADBEE_OVERLAYS_USB
	bool "USB support"
	help
	  USB support

if BR2_PACKAGE_BREADBEE_OVERLAYS_USB
config BR2_PACKAGE_BREADBEE_OVERLAYS_USB_KERNEL_FRAGMENT
	string
	default "$(BR2_EXTERNAL_BREADBEE_PATH)/configs/kernel_fragments/usb"

config  BR2_PACKAGE_BREADBEE_OVERLAYS_USB_AUDIO
	bool "USB audio support"
	select BR2_PACKAGE_XMP
	help
	  USB audio support

if BR2_PACKAGE_BREADBEE_OVERLAYS_USB_AUDIO
config BR2_PACKAGE_BREADBEE_OVERLAYS_USB_AUDIO_KERNEL_FRAGMENT
	string
	default "$(BR2_EXTERNAL_BREADBEE_PATH)/configs/kernel_fragments/usb_audio"

endif
endif

# W1 support
if BR2_PACKAGE_BREADBEE_OVERLAYS_W1
config BR2_PACKAGE_BREADBEE_OVERLAYS_W1_KERNEL_FRAGMENT
        string
        default "$(BR2_EXTERNAL_BREADBEE_PATH)/configs/kernel_fragments/w1"
endif

if BR2_PACKAGE_BREADBEE_OVERLAYS_W1
config BR2_PACKAGE_BREADBEE_OVERLAYS_W1_KERNEL_FRAGMENT
	string
	default "$(BR2_EXTERNAL_BREADBEE_PATH)/configs/kernel_fragments/w1"
endif

# Misc

config  BR2_PACKAGE_BREADBEE_OVERLAYS_EXT4
	bool "EXT4 support"
	depends on BR2_PACKAGE_BREADBEE_OVERLAYS_SD || BR2_PACKAGE_BREADBEE_OVERLAYS_USB
	help
	  EXT4 support

if BR2_PACKAGE_BREADBEE_OVERLAYS_EXT4
config BR2_PACKAGE_BREADBEE_OVERLAYS_EXT4_KERNEL_FRAGMENT
	string
	default "$(BR2_EXTERNAL_BREADBEE_PATH)/configs/kernel_fragments/ext4"
endif

endif
```

## br2breadbee/package/flasher/Config.in
```kconfig
config BR2_PACKAGE_FLASHER
	bool "flasher"
	select BR2_PACKAGE_MTD
	select BR2_PACKAGE_MTD_FLASHCP
	select BR2_PACKAGE_MTD_FLASH_ERASE
	select BR2_PACKAGE_MTD_FLASH_LOCK
	select BR2_PACKAGE_MTD_FLASH_UNLOCK
	help
	  Breadbee flashing script
```

## br2breadbee/package/ptftpd/Config.in
```kconfig
config BR2_PACKAGE_HOST_PTFTPD
        bool "host_pftpd"
	select BR2_PACKAGE_HOST_PYTHON_NETIFACES
	select BR2_PACKAGE_PYTHON3
        help
          Python TFTP server
```

## br2breadbee/package/python-pylx16a/Config.in
```kconfig
config BR2_PACKAGE_PYTHON_PYLX16A
        bool "python-pylx16a"
	select BR2_PACKAGE_PYTHON3
	select BR2_PACKAGE_PYTHON_SERIAL
        help
          python-pylx16a
```

## br2breadbee/package/python-sbus/Config.in
```kconfig
config BR2_PACKAGE_PYTHON_SBUS
        bool "python-sbus"
	select BR2_PACKAGE_PYTHON3
	select BR2_PACKAGE_PYTHON_SERIAL_ASYNCIO
        help
          python-sbus
```

## br2breadbee/package/python-tinyodrive/Config.in
```kconfig
config BR2_PACKAGE_PYTHON_TINYODRIVE
        bool "python-tinyodrive"
	select BR2_PACKAGE_PYTHON3
	select BR2_PACKAGE_PYTHON_SERIAL_ASYNCIO
        help
          python-tinyodrive
```

## br2breadbee/package/sandbox/Config.in
```kconfig
config BR2_PACKAGE_SANDBOX
	bool "sandbox"
	help
	  sandbox

if BR2_PACKAGE_SANDBOX

config BR2_PACKAGE_SANDBOX_NFS
	bool "Sandbox on NFS"
	select BR2_PACKAGE_NFS_UTILS

config BR2_PACKAGE_SANDBOX_NFS_VOLUME
	string "NFS volume"

endif
```

## br2breadbee/package/swankypython/Config.in
```kconfig
config BR2_PACKAGE_SWANKYPYTHON
	bool "swankypython"
	select BR2_PACKAGE_PYTHON3_READLINE
	help
	  Nice default python setup for coding directly on the board
```

## br2breadbee/package/xmp/Config.in
```kconfig
config BR2_PACKAGE_XMP
	bool "xmp"
	select BR2_PACKAGE_LIBXMP
	help
	  XMP module player
```
